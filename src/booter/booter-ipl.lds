/******************************************************************************/
/*                                                                            */
/* src/booter/booter-ipl.lds                                                  */
/*                                                                 2019/07/23 */
/* Copyright (C) 2016-2019 Mochi.                                             */
/*                                                                            */
/******************************************************************************/
OUTPUT_FORMAT( binary )
ENTRY( IplMain )

SECTIONS {
    . = 0;
    .text : { * ( .text ) }
}


/******************************************************************************/
